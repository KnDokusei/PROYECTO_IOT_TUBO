## E1-Mic/main/Kconfig.projbuild
```kconfig
menu "E1-Mic module"

    config E1_DEBUG_STREAM
        bool "Enable the raw-audio WebSocket stream"
        default n
        help
            Streams raw PCM over a binary WebSocket, about 93 KiB/s. It was the
            module's only output before the move to MQTT and is kept purely as a
            debugging aid: it is the one way to look at the analog front end's
            waveform from the PC.

            Leave this OFF for the real module. Beyond the bandwidth, a blocking
            send on a busy link starves the ADC pool, which is what caused the
            sample loss seen during the FIS130 bench run.

    config E1_GOERTZEL_WINDOW
        int "Goertzel window, in samples"
        range 256 16384
        default 4096
        help
            Sets both the measurement's noise rejection and how often the module
            reports. At 44.1 kHz, 4096 samples are 93 ms and a 10.8 Hz bin,
            worth about 33 dB against white noise, and produce roughly 10
            reports per second.

            Doubling it buys 3 dB and halves the report rate. It is the only
            knob for that trade-off, so change this rather than adding a
            separate rate limit.

endmenu
```

## E2-SineGen/main/Kconfig.projbuild
```kconfig
menu "E2-SineGen module"

    config E2_SELFTEST
        bool "Enable bench self-test (no AD9833, no servo)"
        default n
        help
            Validates the module on a bare ESP32 with a single jumper from the
            servo pin to the ADC input. The servo PWM is routed to GPIO25 and
            read back on GPIO34, so the angle-to-pulse mapping can be measured
            without a servo attached.

            Leave this OFF for the real module: it moves the servo signal off
            the pin the schematic uses.

    config E2_SELFTEST_SERVO_GPIO
        int "Servo pin while self-testing"
        depends on E2_SELFTEST
        default 25
        help
            GPIO25 pairs with GPIO34 (ADC1 channel 6) through the same jumper
            used to test module E1.

    config E2_SELFTEST_ADC_CHANNEL
        int "ADC1 channel to sample the PWM on"
        depends on E2_SELFTEST
        default 6
        help
            Channel 6 is GPIO34 on the ESP32.

endmenu
```

## E3-StepMotor/main/Kconfig.projbuild
```kconfig
menu "E3-StepMotor module"

config E3_SPEED_SPS
    int "Velocidad del motor en pasos por segundo"
    range 50 2000
    default 500
    help
      500 pasos/s equivalen a 2 cm/s con el riel de 0,8 cm por revolucion.

config E3_CALIB_SPEED_SPS
    int "Velocidad de busqueda de switches en pasos por segundo"
    range 50 1000
    default 300
    help
      Mas lenta que la de marcha porque la busqueda avanza a proposito
      contra un switch.

endmenu
```

## EC-Cameras/main/Kconfig.projbuild
```kconfig
menu "EC-Cameras module"

    choice EC_FRAMESIZE
        prompt "Frame size"
        default EC_FRAMESIZE_XGA
        help
            XGA matches the Arduino sketch this module replaces. Dropping to
            SVGA or VGA is the cheapest way to cut bandwidth: three cameras at
            XGA share the same 2.4 GHz band as the measurement modules.

        config EC_FRAMESIZE_VGA
            bool "VGA 640x480"
        config EC_FRAMESIZE_SVGA
            bool "SVGA 800x600"
        config EC_FRAMESIZE_XGA
            bool "XGA 1024x768"
    endchoice

    config EC_JPEG_QUALITY
        int "JPEG quality (0 best, 63 worst)"
        range 0 63
        default 12
        help
            The sketch used 10. Slightly lower quality costs little visually and
            takes a noticeable bite out of the frame size.

    config EC_MAX_FPS
        int "Frame rate cap, 0 disables it"
        range 0 30
        default 10
        help
            The sketch streamed as fast as the sensor produced frames. At XGA
            that is several Mbit/s per camera with nobody watching the total.
            Capping is one vTaskDelay and makes the load predictable.

endmenu
```

## components/kundt_config/Kconfig
```kconfig
menu "Kundt tube configuration"

    # Defined here, in the shared component, so all four modules inherit the
    # same symbols instead of each carrying its own copy.

    comment "First-boot defaults. Values are copied into NVS on first boot and"
    comment "can be changed at runtime afterwards without rebuilding."

    config KUNDT_DEFAULT_WIFI_SSID
        string "WiFi SSID"
        default ""
        help
            Leave empty in the repository. Set it locally with menuconfig;
            sdkconfig is git-ignored, so the credential is never committed.

    config KUNDT_DEFAULT_WIFI_PASSWORD
        string "WiFi password"
        default ""
        help
            As above: configure locally, never commit.

    config KUNDT_DEFAULT_SERVER_IP
        string "Server IPv4 address"
        default "192.168.0.100"
        help
            Host running the Kundt lab backend. The WebSocket port is derived
            from the kit number as 8080 + kit.

    config KUNDT_DEFAULT_PLATFORM_ID
        int "curiousBeagle platform id"
        range 1 255
        default 1
        help
            Platform row this rig maps to in the curiousBeagle database. Part of
            the MQTT topic: dev-status/kundt/<platform>/<controller>. It is NOT
            the same numbering as the kit number, so it is configured apart.

    config KUNDT_DEFAULT_CONTROLLER_ID
        int "curiousBeagle controller id"
        range 1 255
        default 1
        help
            Controller row this rig maps to. E1, E2 and E3 share a single
            logical controller and tell themselves apart by which fields they
            publish, so all three carry the same value.

    config KUNDT_DEFAULT_KIT
        int "Kit number"
        range 1 5
        default 1
        help
            Identifies this rig (1..5). Selects the WebSocket port: kit 1 uses
            8081, kit 5 uses 8085.

endmenu
```
